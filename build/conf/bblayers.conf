## build/conf/bblayers.conf
```bitbake
# POKY_BBLAYERS_CONF_VERSION is increased each time build/conf/bblayers.conf
# changes incompatibly
POKY_BBLAYERS_CONF_VERSION = "2"

BBPATH = "${TOPDIR}"
BSPDIR := "${@os.path.abspath(os.path.dirname(d.getVar('FILE', True)) + '/../..')}"
BBFILES ?= ""

BBLAYERS ?= " \
  ${BSPDIR}/layers/poky/meta \
  ${BSPDIR}/layers/poky/meta-poky \
  ${BSPDIR}/layers/poky/meta-yocto-bsp \
  ${BSPDIR}/layers/meta-raspberrypi \
  ${BSPDIR}/layers/meta-silence \
  "
```
